## Config.in
```kconfig
menu "W3M Linux desktop"

config BR2_PACKAGE_W3M
	bool "w3m"
	select BR2_PACKAGE_XLIB_LIBX11
	select BR2_PACKAGE_LUA
	help
	  W3M: gestor de ventanas X11 estilo Windows 3.x
	  (github.com/0ldskoolerz/W3M). Plugins Lua configurables.

config BR2_PACKAGE_W3M_NET
	bool "w3m-net"
	depends on BR2_PACKAGE_BUSYBOX
	help
	  Suite de herramientas de red estilo Trinux para W3M: ping,
	  traceroute, interfaces, puertos, escaneo de LAN, sniffer,
	  monitor de trafico, netcat, DNS, rutas, ARP y estado de
	  enlace (github.com/0ldskoolerz/w3m-net).

config BR2_PACKAGE_W3M_APPS
	bool "w3m-apps"
	select BR2_PACKAGE_BUSYBOX
	help
	  Suite de aplicaciones Win 3.x para W3M: explorador, terminal,
	  administrador de tareas, calculadora y bloc de notas
	  (github.com/0ldskoolerz/w3m-apps). Depende de busybox para la
	  lógica de archivos/procesos.

endmenu
```
